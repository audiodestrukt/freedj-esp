## p4/deck/main/Kconfig.projbuild
```kconfig
menu "freedj deck"

    choice FREEDJ_SCREEN
        prompt "Screen"
        default FREEDJ_SCREEN_4
        help
            Which LCDwiki SPI module is on the header. Both use the same
            14-pin wiring and FT6336 touch on I2C 0x38.

        config FREEDJ_SCREEN_4
            bool "4 inch, 480x320, ST7796S (MSP4021 / MSP4031)"
        config FREEDJ_SCREEN_28
            bool "2.8 inch, 320x240, ILI9341V (MSP2834, Hosyond)"
    endchoice

    config FREEDJ_SCREEN_PREVIEW
        bool "Preview the 2.8 inch layout on the 4 inch panel"
        depends on FREEDJ_SCREEN_28
        default n
        help
            Drive the 4 inch ST7796S as usual but give the UI only its top-left
            320x240. The pixel pitches are close (0.174 vs 0.180 mm), so this shows
            the 2.8 inch layout at almost its real size, touch included.

endmenu
```
